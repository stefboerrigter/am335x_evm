## yocto/touchscreen/conf/bblayers.conf
```bitbake
# LAYER_CONF_VERSION is increased each time build/conf/bblayers.conf
# changes incompatibly
LCONF_VERSION = "6"

BBPATH = "${TOPDIR}"
BBFILES ?= ""

BBLAYERS ?= " \
  /home/boerrs/private/touchscreen/yocto/meta \
  /home/boerrs/private/touchscreen/yocto/meta-yocto \
  /home/boerrs/private/touchscreen/yocto/meta-yocto-bsp \
  /home/boerrs/private/touchscreen/yocto/meta-ti \
  /home/boerrs/private/touchscreen/yocto/meta-qt5 \
  /home/boerrs/private/touchscreen/yocto/meta-openembedded/meta-oe \
  "
BBLAYERS_NON_REMOVABLE ?= " \
  /home/boerrs/private/touchscreen/yocto/meta \
  /home/boerrs/private/touchscreen/yocto/meta-yocto \
  "
```
